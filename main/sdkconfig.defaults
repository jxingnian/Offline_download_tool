## main/sdkconfig.defaults
```kconfig
# TinyUSB 配置
CONFIG_TINYUSB_ENABLED=y
CONFIG_TINYUSB_DESC_USE_ESPRESSIF_VID=n
CONFIG_TINYUSB_DESC_CUSTOM_VID=0x0D28
CONFIG_TINYUSB_DESC_CUSTOM_PID=0x0204

# 启用 BULK 传输
CONFIG_TINYUSB_VENDOR_ENABLED=y
CONFIG_TINYUSB_VENDOR_CUSTOM_CLASS=y

# 禁用其他类
CONFIG_TINYUSB_CDC_ENABLED=y
CONFIG_TINYUSB_MSC_ENABLED=n
CONFIG_TINYUSB_HID_ENABLED=n
CONFIG_TINYUSB_DFU_ENABLED=n
CONFIG_TINYUSB_MIDI_ENABLED=n
CONFIG_TINYUSB_CUSTOM_CLASS_ENABLED=n

# 禁用默认配置描述符
CONFIG_TINYUSB_DESC_USE_DEFAULT=n
CONFIG_TINYUSB_DESC_CUSTOM_CONFIG=y

# USB 配置
CONFIG_TINYUSB_DESC_BCD_DEVICE=0x0100
CONFIG_TINYUSB_DESC_MANUFACTURER_STRING="XING"
CONFIG_TINYUSB_DESC_PRODUCT_STRING="CMSIS-DAP v2"
CONFIG_TINYUSB_DESC_SERIAL_STRING="123456"

# USB 任务配置
CONFIG_TINYUSB_TASK_PRIORITY=5
CONFIG_TINYUSB_TASK_STACK_SIZE=4096

# ESP32 USB OTG 配置
CONFIG_TINYUSB_SELF_POWERED=n
CONFIG_TINYUSB_MAX_POWER=500

# 选择 BULK 模式
CONFIG_BULK_DAPLINK=y
CONFIG_HID_DAPLINK=n

# USB 设备类配置
CONFIG_TINYUSB_CDC_PORT_NUM=1
CONFIG_TINYUSB_CDC_RX_BUFSIZE=64
CONFIG_TINYUSB_CDC_TX_BUFSIZE=64
```
